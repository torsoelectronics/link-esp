## Kconfig
```kconfig
menu "Ableton Link"

    choice LINK_TASK_AFFINITY
        prompt "Link task affinity"
        default LINK_TASK_AFFINITY_NO_AFFINITY
        help
            Allows setting Link tasks affinity, i.e. whether the task is pinned to
            CPU0, pinned to CPU1, or allowed to run on any CPU.

        config LINK_TASK_AFFINITY_NO_AFFINITY
            bool "No affinity"
        config LINK_TASK_AFFINITY_CPU0
            bool "CPU0"
        config LINK_TASK_AFFINITY_CPU1
            bool "CPU1"
            
    endchoice

endmenu
```
